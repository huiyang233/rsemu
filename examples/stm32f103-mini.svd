# STM32F103-MINI register map
Registers are 32-bit, access not given, reset 0x44 unless marked. A register's access mark holds for its fields unless they carry their own. Offsets are from the block's base; lines under a group give offsets from that group; [hi:lo] are bit positions; {n}, {i} and the like mark numbered series; 'fields as' and 'values as' point back to an identical list; <NAME> marks a mode.

## Memory map
0x40010800 GPIOA
0x40013800 USART1

## GPIOA
Base 0x40010800
0x00 CRL
0x0C ODR reset 0x0

## USART1
Base 0x40013800
0x00 SR reset 0xC0
